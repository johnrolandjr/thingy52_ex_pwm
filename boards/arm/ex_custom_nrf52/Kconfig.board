## boards/arm/ex_custom_nrf52/Kconfig.board
```kconfig
# Copyright (c) 2022 Nordic Semiconductor ASA
# SPDX-License-Identifier: Apache-2.0

config BOARD_EX_CUSTOM_NRF52
	bool "Ex Custom Nrf52"
	depends on SOC_NRF52832_CIAA
```

## boards/arm/ex_custom_nrf52/Kconfig.defconfig
```kconfig
# Copyright (c) 2022 Nordic Semiconductor ASA
# SPDX-License-Identifier: Apache-2.0

if BOARD_EX_CUSTOM_NRF52

config BOARD
	default "ex_custom_nrf52"

config BT_CTLR
   default BT

endif
```
